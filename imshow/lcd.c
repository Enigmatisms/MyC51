#include<reg52.h>
#define LCD P0
#define uint unsigned int
#define uchar unsigned char
void Initiallize_LCD();//
void ShowString(uchar x,uchar y,uchar *str);
uchar code Display[31]="Hello world from 51 Panda image";

unsigned char a,i,j,k;
int b;
sbit EN=P2^0;
sbit RW=P2^1;
sbit RS=P2^2;
sbit CS1=P2^3;
sbit CS2=P2^4;
sbit BUSY=P0^0;
char code ch[8][128]={
0x00,0x00,0x00,0x00,0x00,0x00,0x00,0x00,0x00,0x00,0x00,0x00,0x00,0x00,0x00,0x00,
0x80,0x80,0x00,0xC0,0x00,0x00,0x00,0x66,0x70,0x40,0x80,0xF0,0xF8,0xFC,0xFE,0xFE,
0xFF,0xFF,0xFF,0x7F,0x7F,0x7F,0x7E,0x7E,0x7C,0x70,0xE0,0xE0,0xEF,0xE7,0xC3,0xC2,
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0x7F,0x7C,0x7C,0x78,0x10,0x00,0x00,0x00,0x00,0x00,0x00,0x00,0x00,0x00,0x00,0x00,
};

checkbusy()
{
	EN=1;
	RW=1;
	RS=0;
	LCD=0XFF;
}

writecode(unsigned char dat) //???
{ 
	checkbusy();
	EN=1;
	RW=0;
	RS=0;
	LCD=dat;
	EN=1;
	EN=0;
}
writedata(unsigned char dat) //???
{
	checkbusy();
	EN=1;
	RW=0;
	RS=1;
	LCD=dat;
	EN=1;
	EN=0;
}
//??????
void LCDDisplay(unsigned char page,unsigned char lineaddress, unsigned char table[8][128])
{
	for(i=0;i<8;i++)
	{
		if(lineaddress<0X80)
		{
			CS1=0;
			CS2=0;
		}
		writecode(page+i);
		writecode(lineaddress);
		for(j=0;j<64;j++)
		{
			writedata(table[i][j]);
			lineaddress+=1;
		}
		if(lineaddress>=0X80)
		{
			CS1=0;
			CS2=1;
			lineaddress=lineaddress-0X40;
		}
		writecode(page+i);
		writecode(lineaddress);
		for(j=64;j<128;j++)
		{
			writedata(table[i][j]);
			lineaddress+=1;
		}
		if(lineaddress>=0X80)
		{
			lineaddress=lineaddress-0X40;
		} 
	}
	
}

void lcdinit()
{
	writecode(0X3F);
	writecode(0XC0);
	writecode(0XB8);
	writecode(0X40);
}

main()
{
	int i = 0;
	Initiallize_LCD();
	for (i = 0; i < 10; i++){
		ShowString(0,0,Display); //从第一个符幵始湿示
		ShowString(0,1,Display+16);//第ニ行从第17个字符写起，0是第一个字符
	}
	LCDDisplay(0Xb8,0X40,&ch);
	while(1);
}